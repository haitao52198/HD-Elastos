## mantle/Kconfig
```kconfig
#
# Copyright 2014, Tongji Operating System Group & elastos.org
#
# This software may be distributed and modified according to the terms of
# the BSD 2-Clause license. Note that NO WARRANTY is provided.
# See "LICENSE_BSD2.txt" for details.
#
#

# This file defines the Kconfig menu structure.

mainmenu "Project Configuration"

config COMMON_PATH
    string
    option env="COMMON_PATH"

menu "seL4 Libraries"
    source "libs/drivers/Kconfig"
    source "libs/FileSystem/Kconfig"
    source "libs/Net/Kconfig"
endmenu

source "$COMMON_PATH/Kconfig"
```

## mantle/libs/FileSystem/Kconfig
```kconfig
#
# Copyright 2015, Tongji University Operating System Group & elastos.org
#
# This software may be distributed and modified according to the terms of
# the BSD 2-Clause license. Note that NO WARRANTY is provided.
# See "LICENSE_BSD2.txt" for details.
#
#

menuconfig MANTLE_FILESYSTEM
    bool "Mantle FileSystem"
    default y
    depends on LIB_SEL4 && (LIB_MUSL_C || LIB_SEL4_C) && LIB_SEL4_PLAT_SUPPORT && LIB_SEL4_VKA && LIB_SEL4_TEST && LIB_SEL4_UTILS && LIB_UTILS
    help
        HD-Elastos Mantle FileSystem
```

## mantle/libs/Net/Kconfig
```kconfig
#
# Copyright 2015, Tongji University Operating System Group & elastos.org
#
# This software may be distributed and modified according to the terms of
# the BSD 2-Clause license. Note that NO WARRANTY is provided.
# See "LICENSE_BSD2.txt" for details.
#
#

config MANTLE_NET
    bool "Mantle Net"
    default y
    help
        HD-Elastos Mantle Net
```

## zener/apps/ElastosLocalhost/Kconfig
```kconfig
#
#  Copyright 2015, Tongji Operating System Group & elastos.org
#
#  This software may be distributed and modified according to the terms of
#  the BSD 2-Clause license. Note that NO WARRANTY is provided.
#  See "LICENSE_BSD2.txt" for details.
#

menuconfig APP_ELASTOS_LOCALHOST
    bool "Elastos Localhost"
    default n
    depends on LIB_SEL4 && (LIB_MUSL_C || LIB_SEL4_C) && LIB_SEL4_PLAT_SUPPORT && LIB_SEL4_VKA && LIB_SEL4_TEST && LIB_SEL4_UTILS && LIB_UTILS
    help
        HD-Elastos No. 1 process, the core process, the first process, the initial process
```

## zener/apps/lua/Kconfig
```kconfig
#
# Copyright 2014, Tongji Operating System Group
#
# This software may be distributed and modified according to the terms of
# the BSD 2-Clause license. Note that NO WARRANTY is provided.
# See "LICENSE_BSD2.txt" for details.
#
# @TAG(NICTA_BSD)
#

menuconfig Lua
    bool "seL4 init0"
    default n
    depends on LIB_SEL4 && (LIB_MUSL_C || LIB_SEL4_C) && LIB_SEL4_PLAT_SUPPORT && LIB_SEL4_VKA && LIB_SEL4_TEST && LIB_SEL4_UTILS && LIB_UTILS
    help
        seL4 Init0 process, lua shell
```

## zener/libs/libZenerHelpers/Kconfig
```kconfig
#
# Copyright 2015, Tongji Operating System Group & elastos.org
#
# This software may be distributed and modified according to the terms of
# the BSD 2-Clause license. Note that NO WARRANTY is provided.
# See "LICENSE_BSD2.txt" for details.
#
#

config LIB_ZENER_HELPERS
    bool "Zener Helpers library"
    default y
    depends on LIB_SEL4 && HAVE_LIBC
    help
        Zener helpers library and functionality for various platforms
```
